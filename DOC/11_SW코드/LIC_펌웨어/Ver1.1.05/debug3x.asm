;******************************************************************************
;* TMS320C3x/4x ANSI C Code Generator                            Version 5.11 *
;* Date/Time created: Mon Apr 16 19:12:09 2018                                *
;******************************************************************************
	.regalias	; enable floating point register aliases
fp	.set	ar3
FP	.set	ar3
;******************************************************************************
;* GLOBAL FILE PARAMETERS                                                     *
;*                                                                            *
;*   Optimization       : Always Choose Smaller Code Size                     *
;*   Memory             : Small Memory Model                                  *
;*   Float-to-Int       : Normal Conversions (round toward zero)              *
;*   Multiply           : in Hardware (24 bits max)                           *
;*   Memory Info        : Unmapped Memory Exists                              *
;*   Repeat Loops       : Use RPTS and/or RPTB                                *
;*   Calls              : Normal Library ASM calls                            *
;*   Debug Info         : Optimized TI Debug Information                      *
;******************************************************************************
;	c:\lang\tms320c3x\511\bin\ac30.exe debug3x.c C:\Users\JDS_DELL\AppData\Local\Temp\debug3x.if 
	.file	"debug3x.c"
	.sect	 ".text"

	.global	_c_int06
	.sym	_c_int06,_c_int06,32,2,0
	.func	13
;******************************************************************************
;* FUNCTION NAME: _c_int06                                                    *
;*                                                                            *
;*   Architecture       : TMS320C30                                           *
;*   Calling Convention : Stack Parameter Convention                          *
;*   Function Uses Regs : r0,ar0,st                                           *
;*   Regs Saved         : f0,r0,ar0,pc                                        *
;*   Stack Frame        : Full (w/ debug)                                     *
;*   Total Frame Size   : 2 Call + 0 Parm + 2 Auto + 3 SOE = 7 words          *
;******************************************************************************
_c_int06:
	.sym	_nRXData,1,15,1,32
	.sym	_nTXData,2,15,1,32
	.line	1
;----------------------------------------------------------------------
;  13 | void c_int06()                                                         
;  15 | unsigned long nRXData;                                                 
;  16 | unsigned long nTXData;                                                 
;----------------------------------------------------------------------
        push      st
        push      fp
        ldiu      sp,fp
        addi      2,sp
        push      r0
        pushf     f0
        push      ar0
	.line	6
;----------------------------------------------------------------------
;  18 | nRXData = *(unsigned long *)0x80804c;                                  
;  20 | switch(nRXData >> 24)                                                  
;  22 |         case 0x00:                                                     
;----------------------------------------------------------------------
        bud       L12
        ldiu      @CL1,ar0
        ldiu      *ar0,r0
        sti       r0,*+fp(1)
;*      Branch Occurs to L12 
L2:        
	.line	11
;----------------------------------------------------------------------
;  23 | nTXData = *(unsigned long *)nRXData;                                   
;----------------------------------------------------------------------
        ldiu      *+fp(1),ar0
        ldiu      *ar0,r0
        sti       r0,*+fp(2)
	.line	12
;----------------------------------------------------------------------
;  24 | break;                                                                 
;  26 | case 0x1D:                                                             
;----------------------------------------------------------------------
        bu        L20
;*      Branch Occurs to L20 
L3:        
	.line	15
;----------------------------------------------------------------------
;  27 | nTXData = DEBUG_3X_ID_VALUE;                                           
;----------------------------------------------------------------------
        ldiu      @CL2,r0
        sti       r0,*+fp(2)
	.line	16
;----------------------------------------------------------------------
;  28 | break;                                                                 
;  30 | case 0x88:                                                             
;----------------------------------------------------------------------
        bu        L20
;*      Branch Occurs to L20 
L4:        
	.line	19
;----------------------------------------------------------------------
;  31 | nTXData = 0x12345678;                                                  
;----------------------------------------------------------------------
        ldiu      @CL2,r0
        sti       r0,*+fp(2)
	.line	20
;----------------------------------------------------------------------
;  32 | break;                                                                 
;  34 | case 0xAD:                                                             
;----------------------------------------------------------------------
        bu        L20
;*      Branch Occurs to L20 
L5:        
	.line	23
;----------------------------------------------------------------------
;  35 | _glDebugAddr = nRXData & 0xffffff;                                     
;----------------------------------------------------------------------
        ldiu      @CL3,r0
        and       *+fp(1),r0
        sti       r0,@__glDebugAddr+0
	.line	24
;----------------------------------------------------------------------
;  36 | nTXData = _glDebugAddr;                                                
;----------------------------------------------------------------------
        sti       r0,*+fp(2)
	.line	25
;----------------------------------------------------------------------
;  37 | break;                                                                 
;  39 | case 0xD1:                                                             
;----------------------------------------------------------------------
        bu        L20
;*      Branch Occurs to L20 
L6:        
	.line	28
;----------------------------------------------------------------------
;  40 | _glDebugData = (nRXData << 16) & 0xffff0000;                           
;----------------------------------------------------------------------
        ldiu      *+fp(1),r0
        ash       16,r0
        andn      65535,r0
        sti       r0,@__glDebugData+0
	.line	29
;----------------------------------------------------------------------
;  41 | nTXData = _glDebugData;                                                
;----------------------------------------------------------------------
        sti       r0,*+fp(2)
	.line	30
;----------------------------------------------------------------------
;  42 | break;                                                                 
;  44 | case 0xD0:                                                             
;----------------------------------------------------------------------
        bu        L20
;*      Branch Occurs to L20 
L7:        
	.line	33
;----------------------------------------------------------------------
;  45 | _glDebugData |= (nRXData & 0xffff);                                    
;----------------------------------------------------------------------
        ldiu      *+fp(1),r0
        and       65535,r0
        or        @__glDebugData+0,r0
        sti       r0,@__glDebugData+0
	.line	34
;----------------------------------------------------------------------
;  46 | nTXData = _glDebugData;                                                
;----------------------------------------------------------------------
        sti       r0,*+fp(2)
	.line	35
;----------------------------------------------------------------------
;  47 | break;                                                                 
;  49 | case 0x33:                                                             
;----------------------------------------------------------------------
        bu        L20
;*      Branch Occurs to L20 
	.line	38
;----------------------------------------------------------------------
;  50 | *(unsigned long *)_glDebugAddr = _glDebugData;                         
;----------------------------------------------------------------------
L9:        
        sti       r0,*ar0
	.line	39
;----------------------------------------------------------------------
;  51 | break;                                                                 
;  53 | default:                                                               
;----------------------------------------------------------------------
        bu        L20
;*      Branch Occurs to L20 
	.line	42
;----------------------------------------------------------------------
;  54 | nTXData = 0xffffffff;                                                  
;----------------------------------------------------------------------
	.line	43
;----------------------------------------------------------------------
;  55 | break;                                                                 
;----------------------------------------------------------------------
L12:        
	.line	8
        ldiu      *+fp(1),r0
        lsh       -24,r0
        beq       L2
;*      Branch Occurs to L2 
        cmpi      29,r0
        beq       L3
;*      Branch Occurs to L3 
        cmpi      51,r0
        beqd      L9
	nop
        ldieq     @__glDebugAddr+0,ar0
        ldieq     @__glDebugData+0,r0
;*      Branch Occurs to L9 
        cmpi      136,r0
        beq       L4
;*      Branch Occurs to L4 
        cmpi      173,r0
        beq       L5
;*      Branch Occurs to L5 
        cmpi      208,r0
        beq       L7
;*      Branch Occurs to L7 
        cmpi      209,r0
        beq       L6
;*      Branch Occurs to L6 
        ldiu      @CL4,r0
        sti       r0,*+fp(2)
L20:        
	.line	46
;----------------------------------------------------------------------
;  58 | *(unsigned long *)0x808048 = nTXData;                                  
;----------------------------------------------------------------------
        ldiu      @CL5,ar0
        ldiu      *+fp(2),r0
        sti       r0,*ar0
	.line	47
        pop       ar0
        popf      f0
        pop       r0
        subi      2,sp
        pop       fp
        pop       st
        reti
                                        	; Return From Interrupt
	.endfunc	59,000000101h,2


	.sect	 ".text"

	.global	_Debug3xInit
	.sym	_Debug3xInit,_Debug3xInit,32,2,0
	.func	80
;******************************************************************************
;* FUNCTION NAME: _Debug3xInit                                                *
;*                                                                            *
;*   Architecture       : TMS320C30                                           *
;*   Calling Convention : Stack Parameter Convention                          *
;*   Function Uses Regs : r0,ar0,st                                           *
;*   Regs Saved         :                                                     *
;*   Stack Frame        : Full (w/ debug)                                     *
;*   Total Frame Size   : 2 Call + 1 Parm + 1 Auto + 0 SOE = 4 words          *
;******************************************************************************
_Debug3xInit:
	.sym	_nKind,-2,12,9,32
	.sym	_nTemp,1,4,1,32
	.line	1
;----------------------------------------------------------------------
;  80 | void Debug3xInit(unsigned char nKind)                                  
;----------------------------------------------------------------------
        push      fp
        ldiu      sp,fp
        addi      1,sp
	.line	2
;----------------------------------------------------------------------
;  82 | int nTemp;                                                             
;----------------------------------------------------------------------
	.line	5
;----------------------------------------------------------------------
;  84 | *(unsigned long *)0x808042 = 0x111;                                    
;----------------------------------------------------------------------
        ldiu      @CL6,ar0
        ldiu      273,r0
        sti       r0,*ar0
	.line	6
;----------------------------------------------------------------------
;  85 | *(unsigned long *)0x808040 = 0x0e3c0000;                               
;----------------------------------------------------------------------
        ldiu      @CL7,ar0
        ldiu      @CL8,r0
        sti       r0,*ar0
	.line	7
;----------------------------------------------------------------------
;  86 | nTemp = *(unsigned long *)0x80804c;                                    
;  88 | switch(nKind)                                                          
;  90 | default:                                                               
;  94 | case TMS320C31:                                                        
;  95 | case TMS320C33:                                                        
;----------------------------------------------------------------------
        bud       L28
        ldiu      @CL1,ar0
        ldiu      *ar0,r0
        sti       r0,*+fp(1)
;*      Branch Occurs to L28 
L24:        
	.line	17
;----------------------------------------------------------------------
;  96 | (*(unsigned long *)0x809fc6) = 0x60000000 | (int)c_int06;              
;----------------------------------------------------------------------
        ldiu      @CL10,r0
        ldiu      @CL9,ar0
        or        @CL11,r0
        sti       r0,*ar0
	.line	18
;----------------------------------------------------------------------
;  97 | break;                                                                 
; 102 | case TMS320C32:                                                        
;----------------------------------------------------------------------
        bu        L32
;*      Branch Occurs to L32 
	.line	24
;----------------------------------------------------------------------
; 103 | (*(unsigned long *)0x87fe06) = 0x60000000 | (int)c_int06;              
; 105 | // 인터럽트 벡터를 다시 구성한다.                                      
;----------------------------------------------------------------------
L26:        
        or        @CL11,r0
        sti       r0,*ar0
	.line	27
;----------------------------------------------------------------------
; 106 | asm("   LDI     87feh, IF ");                                          
;----------------------------------------------------------------------
   LDI     87feh, IF 
	.line	28
;----------------------------------------------------------------------
; 107 | asm("   LSH     10h, IF ");     // 0x87fe0000 <---------------         
;----------------------------------------------------------------------
   LSH     10h, IF 
	.line	29
;----------------------------------------------------------------------
; 108 | break;                                                                 
; 111 | // 인터럽트를 활성화 시킨다.                                           
;----------------------------------------------------------------------
        bu        L32
;*      Branch Occurs to L32 
L28:        
	.line	9
        ldiu      *-fp(2),r0
        cmpi      31,r0
        beq       L24
;*      Branch Occurs to L24 
        cmpi      32,r0
        beqd      L26
	nop
        ldieq     @CL10,r0
        ldieq     @CL12,ar0
;*      Branch Occurs to L26 
        cmpi      33,r0
        beq       L24
;*      Branch Occurs to L24 
        bu        L24
;*      Branch Occurs to L24 
L32:        
	.line	33
;----------------------------------------------------------------------
; 112 | asm("   OR      0020h,IE");                                            
;----------------------------------------------------------------------
	OR	0020h,IE
	.line	34
        ldiu      *-fp(1),ar0
        ldiu      *fp,fp
        subi      3,sp
        bu        ar0
;*      Branch Occurs to ar0 
	.endfunc	113,000000000h,1



	.global	__glDebugData
	.bss	__glDebugData,1
	.sym	__glDebugData,__glDebugData,15,2,32

	.global	__glDebugAddr
	.bss	__glDebugAddr,1
	.sym	__glDebugAddr,__glDebugAddr,15,2,32
;******************************************************************************
;* CONSTANT TABLE                                                             *
;******************************************************************************
	.sect	".const"
	.bss	CL1,1
	.bss	CL2,1
	.bss	CL3,1
	.bss	CL4,1
	.bss	CL5,1
	.bss	CL6,1
	.bss	CL7,1
	.bss	CL8,1
	.bss	CL9,1
	.bss	CL10,1
	.bss	CL11,1
	.bss	CL12,1

	.sect	".cinit"
	.field  	12,32
	.field  	CL1+0,32
	.field  	8421452,32
	.field  	305419896,32
	.field  	16777215,32
	.field  	-1,32
	.field  	8421448,32
	.field  	8421442,32
	.field  	8421440,32
	.field  	238813184,32
	.field  	8429510,32
	.field  	1610612736,32
	.field  	_c_int06,32
	.field  	8912390,32

	.sect	".text"
